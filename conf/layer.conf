## conf/layer.conf
```bitbake
# We have a conf and classes directory, add to BBPATH
BBPATH .= ":${LAYERDIR}"

# We have recipes-* directories, add to BBFILES
BBFILES += "${LAYERDIR}/recipes-*/*/*.bb \
	${LAYERDIR}/recipes-*/*/*.bbappend"

BBFILE_COLLECTIONS += "qt5-demos"
BBFILE_PATTERN_qt5-demos = "^${LAYERDIR}/"
BBFILE_PRIORITY_qt5-demos = "14"
```
